## main/Kconfig.projbuild
```kconfig
menu "Spotify ESP"

    config SPOTIFY_DEVICE_NAME
        string "Spotify Connect device name (default, can be changed in the setup portal)"
        default "Spotify ESP"

    config SPOTIFY_WIFI_SSID
        string "WiFi SSID (leave empty to use the setup portal)"
        default ""

    config SPOTIFY_WIFI_PASSWORD
        string "WiFi password"
        default ""

    config SPOTIFY_SETUP_AP_SSID
        string "Name prefix of the WiFi setup access point"
        default "SpotifyESP-Setup"

    config SPOTIFY_SETUP_BUTTON_GPIO
        int "GPIO of the button that opens the WiFi setup portal (-1 to disable)"
        default 0
        help
            Hold the button for 3 seconds after the board has started and release it.
            GPIO0 is the BOOT button on the supported boards.

    config SPOTIFY_I2S_BCLK
        int "I2S BCK pin (PCM5102 BCK)"
        default 5

    config SPOTIFY_I2S_LRCLK
        int "I2S LRCK/WS pin (PCM5102 LCK)"
        default 4

    config SPOTIFY_I2S_DOUT
        int "I2S data out pin (PCM5102 DIN)"
        default 6

    config SPOTIFY_ETHERNET
        bool "Use a W5500 SPI Ethernet module (WiFi stays as a fallback)"
        default n

    config SPOTIFY_ETH_SPI_CLK
        int "W5500 SPI CLK pin"
        depends on SPOTIFY_ETHERNET
        default 12

    config SPOTIFY_ETH_SPI_MOSI
        int "W5500 SPI MOSI pin"
        depends on SPOTIFY_ETHERNET
        default 11

    config SPOTIFY_ETH_SPI_MISO
        int "W5500 SPI MISO pin"
        depends on SPOTIFY_ETHERNET
        default 13

    config SPOTIFY_ETH_CS
        int "W5500 chip select pin"
        depends on SPOTIFY_ETHERNET
        default 10

    config SPOTIFY_ETH_INT
        int "W5500 interrupt pin"
        depends on SPOTIFY_ETHERNET
        default 6

    config SPOTIFY_ETH_RST
        int "W5500 reset pin (-1 if not connected)"
        depends on SPOTIFY_ETHERNET
        default 5

    config SPOTIFY_ETH_TIMEOUT_S
        int "Seconds to wait for an Ethernet address before falling back to WiFi"
        depends on SPOTIFY_ETHERNET
        default 15

    config SPOTIFY_PCM5122
        bool "Initialise a PCM5122 DAC over I2C (instead of a PCM5102)"
        default n

    config SPOTIFY_PCM5122_SDA
        int "PCM5122 I2C SDA pin"
        depends on SPOTIFY_PCM5122
        default 42

    config SPOTIFY_PCM5122_SCL
        int "PCM5122 I2C SCL pin"
        depends on SPOTIFY_PCM5122
        default 41

    config SPOTIFY_PCM5122_ADDR
        int "PCM5122 I2C address (0x4C on rev H, 0x4D on rev H1 and later)"
        depends on SPOTIFY_PCM5122
        default 77

    config SPOTIFY_PCM5122_XSMT
        int "PCM5122 XSMT (unmute) pin, driven high (-1 if not connected)"
        depends on SPOTIFY_PCM5122
        default 4

endmenu
```

## sdkconfig.defaults
```kconfig
CONFIG_IDF_TARGET="esp32s3"

CONFIG_ESPTOOLPY_FLASHSIZE_16MB=y
CONFIG_PARTITION_TABLE_CUSTOM=y
CONFIG_PARTITION_TABLE_CUSTOM_FILENAME="partitions.csv"

CONFIG_ESP_DEFAULT_CPU_FREQ_MHZ_240=y
CONFIG_COMPILER_CXX_EXCEPTIONS=y
CONFIG_COMPILER_CXX_EXCEPTIONS_EMG_POOL_SIZE=0

# 8 MB PSRAM
CONFIG_SPIRAM=y
CONFIG_SPIRAM_MODE_OCT=y
CONFIG_SPIRAM_SPEED_80M=y
CONFIG_SPIRAM_USE_MALLOC=y
CONFIG_SPIRAM_MALLOC_ALWAYSINTERNAL=16384
CONFIG_SPIRAM_TRY_ALLOCATE_WIFI_LWIP=y
CONFIG_SPIRAM_ALLOW_STACK_EXTERNAL_MEMORY=y
CONFIG_FREERTOS_TASK_CREATE_ALLOW_EXT_MEM=y

CONFIG_FREERTOS_HZ=1000
CONFIG_ESP_MAIN_TASK_STACK_SIZE=8192
CONFIG_ESP_TASK_WDT_EN=n

CONFIG_LWIP_MAX_SOCKETS=16
CONFIG_LWIP_MAX_ACTIVE_TCP=16
CONFIG_LWIP_MAX_LISTENING_TCP=16

CONFIG_MBEDTLS_EXTERNAL_MEM_ALLOC=y
CONFIG_MBEDTLS_ASYMMETRIC_CONTENT_LEN=y
CONFIG_MBEDTLS_SSL_IN_CONTENT_LEN=16384
CONFIG_MBEDTLS_SSL_OUT_CONTENT_LEN=4096
CONFIG_MBEDTLS_ECDH_LEGACY_CONTEXT=y
CONFIG_MBEDTLS_SSL_KEEP_PEER_CERTIFICATE=y
CONFIG_MBEDTLS_CERTIFICATE_BUNDLE=y
CONFIG_MBEDTLS_CMAC_C=y
CONFIG_MBEDTLS_HARDWARE_AES=y
```
